#ifndef OS_MASTER_FILE
#define OS_GLOBALS
#include "includes.h"
#endif

#if (_TH_)

#define _TEMP_TOTAL_NUM_ (161)
#define _ADC_REF_VOL_    (3.3)
#define _ADC_BIT_NUM_    (4096)  //2^12
#define _NTC_PULL_UP_    (10000) //resistor 10K
#define _TEMP_MIN_       (0000)
#define _TEMP_MAX_       (1600)

/********************************************************************/ /**
 * @brief:      Temprature table
 *
 * @param[in]:  NONE
 *
 * @return:     NONE
 *********************************************************************/
const uint16_t TempAD_Tab[_TEMP_TOTAL_NUM_] = {
    /*
  55240,//-10
  52348,//-9
  49626,//-8
  47065,//-7
  44653,//-6
  42379,//-5
  40236,//-4
  38214,//-3
  36306,//-2
  34504,//-1
  */
    32802, //0
    31194, //1
    29673, //2
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    129,   //160
    /*
    126,//161
    123,//162
    121,//163
    118,//164
    115,//165
    113,//166
    110,//167
    108,//168
    106,//169
    103,//170
    */
};

/********************************************************************/ /**
 * @brief:      Get Temp Sensor Adc value
 *
 * @param[in]:  NONE
 *
 * @return:     NONE
 *********************************************************************/
uint16_t GetTemperatureAdcValue(void)
{
    uint8_t i;
    uint16_t adBuf[5];
    uint16_t adVal;

    for (i = 0; i < 5; i++) {
        adBuf[i] = ADConversion(ADC_Channel_17);
    }

    /*Min -> Max,taxis*/
    SortRoutine(adBuf, 5);

    /*delete Min and Max A/D value,calc average*/
    adVal = GetAverageValue(adBuf, 5);

    return adVal;
}

int16_t ReadTemperatureSensor(void)
{
    uint8_t i;
    int16_t temp = _TEMP_MIN_;
    uint16_t adVal;
    float Voltage;
    float NTC_Resistance;

    adVal = GetTemperatureAdcValue();

    Voltage        = adVal * TVGain * _ADC_REF_VOL_ / _ADC_BIT_NUM_;
    NTC_Resistance = Voltage * _NTC_PULL_UP_ / (_ADC_REF_VOL_ - Voltage);
    adVal          = (uint16_t)(NTC_Resistance / 10);

    //lock-up table
    for (i = 0; i < _TEMP_TOTAL_NUM_; i++) {
        if (adVal >= TempAD_Tab[i]) {
            break;
        }
        temp += 10;
    }

    if (i == 0) {
        temp = _TEMP_MIN_;
    } else if (i > _TEMP_TOTAL_NUM_) {
        temp = _TEMP_MAX_;
    } else {
        temp = temp - (adVal - TempAD_Tab[i]) / ((TempAD_Tab[i - 1] - TempAD_Tab[i]) / 10);
    }

    return temp;
}

#else

int16_t ReadTemperatureSensor(void);

#endif
